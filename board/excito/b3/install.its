## board/excito/b3/install.its
```
/dts-v1/;


/ {
	description = "B3 install/rescue image";
	#address-cells = <0x00000001>;

	images {
		kernel@1 {
			description = "kernel-6.1.14-b3-install";
			data = /incbin/("./zImage.b3");
			type = "kernel";
			arch = "arm";
			os = "linux";
			compression = "none";
			load = <0x00008000>;
			entry = <0x00008000>;
			hash@1 {
				algo = "md5";
			};
			hash@2 {
				algo = "sha1";
			};
		};

		ramdisk@1 {
			description = "Excito B3 rescue/install system";
			data = /incbin/("./rootfs.cpio.gz");
			type = "ramdisk";
			arch = "arm";
			os = "linux";
			load = <0x02000000>;
			compression = "gzip";
			hash@1 {
				algo = "sha1";
			};
		};

	};

	configurations {
		default = "config@1";

		config@1 {
			description = "Excito B3 install/rescue system config";
			kernel = "kernel@1";
			ramdisk = "ramdisk@1";
		};
	};
};
```

## board/excito/bubbatwo/install.its
```
/dts-v1/;

/ {
	description = "BUBBA|2 install/rescue image";
	#address-cells = <0x00000001>;

	images {

		kernel@1 {
			description = "shimmed kernel-3.8.21-bubbatwo-install";
			data = /incbin/("./reloc_shim_itb.bin");
			type = "kernel";
			arch = "ppc";
			os = "linux";
			compression = "none";
			load = <0x02000000>;
			entry = <0x02000000>;
			hash@1 {
				algo = "sha1";
			};
		};

		ramdisk@1 {
			description = "Excito BUBBA|2 rescue/install system";
			data = /incbin/("./rootfs.cpio.gz");
			type = "ramdisk";
			arch = "ppc";
			os = "linux";
			load = <0x02700000>;
			compression = "gzip";
			hash@1 {
				algo = "sha1";
			};
		};

		fdt@1 {
			description = "install-fdt";
			data = /incbin/("install.dtb");
			type = "flat_dt";
			arch = "ppc";
			compression = "none";

			hash@1 {
				algo = "crc32";
			};
		};
	};

	configurations {
		default = "config@1";

		config@1 {
			description = "Excito BUBBA|2 install/rescue system config";
			kernel = "kernel@1";
			ramdisk = "ramdisk@1";
			fdt = "fdt@1";
		};
	};
};
```

## configs/excito_b3_step1_defconfig
```kconfig
BR2_arm=y
BR2_CCACHE=y
BR2_CCACHE_DIR="$(HOME)/.buildroot-ccache-step1"
BR2_KERNEL_HEADERS_3_18=y
BR2_PTHREADS_NONE=y
# BR2_UCLIBC_INSTALL_UTILS is not set
BR2_TARGET_GENERIC_HOSTNAME="b3-install"
BR2_TARGET_GENERIC_ISSUE="Welcome to Excito B3 Rescue/Install"
BR2_INIT_NONE=y
BR2_ROOTFS_DEVICE_CREATION_STATIC=y
BR2_ROOTFS_SKELETON_CUSTOM=y
BR2_ROOTFS_SKELETON_CUSTOM_PATH="board/excito/common/rootfs-step1-overlay"
BR2_ROOTFS_POST_BUILD_SCRIPT="board/excito/common/post-build-step1.sh"
BR2_ROOTFS_POST_IMAGE_SCRIPT="board/excito/b3/post-image-step1.sh"
BR2_LINUX_KERNEL=y
BR2_LINUX_KERNEL_CUSTOM_VERSION=y
BR2_LINUX_KERNEL_CUSTOM_VERSION_VALUE="3.18.21"
BR2_LINUX_KERNEL_PATCH="board/excito/b3/linux-3.18.21.patch"
BR2_LINUX_KERNEL_USE_CUSTOM_CONFIG=y
BR2_LINUX_KERNEL_CUSTOM_CONFIG_FILE="board/excito/b3/linux-3.18.21.config"
BR2_LINUX_KERNEL_ZIMAGE=y
BR2_LINUX_KERNEL_DTS_SUPPORT=y
BR2_LINUX_KERNEL_INTREE_DTS_NAME="kirkwood-b3"
BR2_PACKAGE_BUSYBOX_CONFIG_FRAGMENT_FILES="board/excito/common/busybox-step1.config"
BR2_TARGET_ROOTFS_CPIO=y
BR2_TARGET_ROOTFS_CPIO_GZIP=y
# BR2_TARGET_ROOTFS_TAR is not set
BR2_PACKAGE_HOST_UBOOT_TOOLS=y
```

## configs/excito_bubbatwo_defconfig
```kconfig
BR2_powerpc=y
BR2_powerpc_e300c3=y
BR2_CCACHE=y
BR2_GLOBAL_PATCH_DIR="board/excito/bubbatwo/patches"
BR2_KERNEL_HEADERS_3_18=y
BR2_UCLIBC_CONFIG="board/excito/bubbatwo/uclibc.config"
BR2_TOOLCHAIN_BUILDROOT_WCHAR=y
BR2_TOOLCHAIN_BUILDROOT_CXX=y
BR2_TARGET_GENERIC_HOSTNAME="bubbatwo-install"
BR2_TARGET_GENERIC_ISSUE="Welcome to Excito Bubba|2 Rescue/Install"
BR2_TARGET_GENERIC_PASSWD_SHA512=y
BR2_TARGET_GENERIC_ROOT_PASSWD="excito"
BR2_SYSTEM_BIN_SH_BASH=y
BR2_ROOTFS_OVERLAY="board/excito/common/rootfs-overlay board/excito/bubbatwo/rootfs-overlay"
BR2_ROOTFS_POST_IMAGE_SCRIPT="board/excito/bubbatwo/post_image.sh"
BR2_LINUX_KERNEL=y
BR2_LINUX_KERNEL_CUSTOM_VERSION=y
BR2_LINUX_KERNEL_CUSTOM_VERSION_VALUE="3.18.21"
BR2_LINUX_KERNEL_PATCH="board/excito/bubbatwo/linux-3.18.21.patch"
BR2_LINUX_KERNEL_USE_CUSTOM_CONFIG=y
BR2_LINUX_KERNEL_CUSTOM_CONFIG_FILE="board/excito/bubbatwo/linux-3.18.21.config"
BR2_LINUX_KERNEL_VMLINUX=y
BR2_PACKAGE_BUSYBOX_CONFIG="board/excito/common/busybox.config"
BR2_PACKAGE_BUSYBOX_SHOW_OTHERS=y
BR2_PACKAGE_BTRFS_PROGS=y
BR2_PACKAGE_CIFS_UTILS=y
BR2_PACKAGE_DOSFSTOOLS=y
BR2_PACKAGE_DOSFSTOOLS_FATLABEL=y
BR2_PACKAGE_DOSFSTOOLS_FSCK_FAT=y
BR2_PACKAGE_DOSFSTOOLS_MKFS_FAT=y
BR2_PACKAGE_E2FSPROGS_RESIZE2FS=y
BR2_PACKAGE_ECRYPTFS_UTILS=y
BR2_PACKAGE_FSARCHIVER=y
BR2_PACKAGE_MTD=y
# BR2_PACKAGE_MTD_UBIATTACH is not set
# BR2_PACKAGE_MTD_UBICRC32 is not set
# BR2_PACKAGE_MTD_UBIDETACH is not set
# BR2_PACKAGE_MTD_UBIFORMAT is not set
# BR2_PACKAGE_MTD_UBIMKVOL is not set
# BR2_PACKAGE_MTD_UBINFO is not set
# BR2_PACKAGE_MTD_UBINIZE is not set
# BR2_PACKAGE_MTD_UBIRENAME is not set
# BR2_PACKAGE_MTD_UBIRMVOL is not set
# BR2_PACKAGE_MTD_UBIRSVOL is not set
# BR2_PACKAGE_MTD_UBIUPDATEVOL is not set
# BR2_PACKAGE_MTD_UBIBLOCK is not set
BR2_PACKAGE_XFSPROGS=y
BR2_PACKAGE_CRYPTSETUP=y
BR2_PACKAGE_GPTFDISK=y
BR2_PACKAGE_GPTFDISK_GDISK=y
BR2_PACKAGE_GPTFDISK_SGDISK=y
BR2_PACKAGE_HDPARM=y
BR2_PACKAGE_MDADM=y
BR2_PACKAGE_UBOOT_TOOLS=y
BR2_PACKAGE_PYTHON=y
BR2_PACKAGE_PYTHON_SSL=y
# BR2_PACKAGE_PYTHON_UNICODEDATA is not set
BR2_PACKAGE_PYTHON_ZLIB=y
BR2_PACKAGE_PYTHON_DAEMON=y
BR2_PACKAGE_PYTHON_NETIFACES=y
BR2_PACKAGE_PYTHON_POSIX_IPC=y
BR2_PACKAGE_PYTHON_SIMPLEJSON=y
BR2_PACKAGE_DROPBEAR=y
BR2_PACKAGE_IFPLUGD=y
BR2_PACKAGE_NETCAT=y
BR2_PACKAGE_CDEBOOTSTRAP=y
BR2_PACKAGE_DEBOOTSTRAP=y
BR2_PACKAGE_UTIL_LINUX_BINARIES=y
BR2_TARGET_ROOTFS_EXT2=y
BR2_TARGET_ROOTFS_EXT2_GZIP=y
# BR2_TARGET_ROOTFS_TAR is not set
BR2_PACKAGE_HOST_UBOOT_TOOLS=y
```

## configs/excito_bubbatwo_step2_defconfig
```kconfig
BR2_powerpc=y
BR2_powerpc_e300c3=y
BR2_CCACHE=y
BR2_CCACHE_DIR="$(HOME)/.buildroot-ccache-step2"
BR2_GLOBAL_PATCH_DIR="board/excito/bubbatwo/patches"
BR2_KERNEL_HEADERS_3_18=y
BR2_UCLIBC_CONFIG_FRAGMENT_FILES="board/excito/common/uclibc-step2.config"
BR2_TOOLCHAIN_BUILDROOT_WCHAR=y
BR2_TOOLCHAIN_BUILDROOT_CXX=y
BR2_TARGET_GENERIC_HOSTNAME="bubbatwo-install"
BR2_TARGET_GENERIC_ISSUE="Welcome to Excito Bubba|2 Rescue/Install"
BR2_TARGET_GENERIC_ROOT_PASSWD="excito"
BR2_SYSTEM_BIN_SH_BASH=y
BR2_ROOTFS_OVERLAY="board/excito/common/rootfs-step2-overlay board/excito/bubbatwo/rootfs-step2-overlay"
BR2_ROOTFS_POST_BUILD_SCRIPT="board/excito/common/post-build-step2.sh"
BR2_ROOTFS_POST_IMAGE_SCRIPT="board/excito/common/post-image-step2.sh"
BR2_PACKAGE_BUSYBOX_CONFIG_FRAGMENT_FILES="board/excito/common/busybox-step2.config"
BR2_PACKAGE_BUSYBOX_SHOW_OTHERS=y
BR2_PACKAGE_BTRFS_PROGS=y
BR2_PACKAGE_CIFS_UTILS=y
BR2_PACKAGE_DOSFSTOOLS=y
BR2_PACKAGE_DOSFSTOOLS_FATLABEL=y
BR2_PACKAGE_DOSFSTOOLS_FSCK_FAT=y
BR2_PACKAGE_DOSFSTOOLS_MKFS_FAT=y
BR2_PACKAGE_E2FSPROGS_RESIZE2FS=y
BR2_PACKAGE_ECRYPTFS_UTILS=y
BR2_PACKAGE_FSARCHIVER=y
BR2_PACKAGE_MTD=y
# BR2_PACKAGE_MTD_UBIATTACH is not set
# BR2_PACKAGE_MTD_UBICRC32 is not set
# BR2_PACKAGE_MTD_UBIDETACH is not set
# BR2_PACKAGE_MTD_UBIFORMAT is not set
# BR2_PACKAGE_MTD_UBIMKVOL is not set
# BR2_PACKAGE_MTD_UBINFO is not set
# BR2_PACKAGE_MTD_UBINIZE is not set
# BR2_PACKAGE_MTD_UBIRENAME is not set
# BR2_PACKAGE_MTD_UBIRMVOL is not set
# BR2_PACKAGE_MTD_UBIRSVOL is not set
# BR2_PACKAGE_MTD_UBIUPDATEVOL is not set
# BR2_PACKAGE_MTD_UBIBLOCK is not set
BR2_PACKAGE_XFSPROGS=y
BR2_PACKAGE_CRYPTSETUP=y
BR2_PACKAGE_GPTFDISK=y
BR2_PACKAGE_GPTFDISK_GDISK=y
BR2_PACKAGE_GPTFDISK_SGDISK=y
BR2_PACKAGE_HDPARM=y
BR2_PACKAGE_MDADM=y
BR2_PACKAGE_UBOOT_TOOLS=y
BR2_PACKAGE_PYTHON=y
BR2_PACKAGE_PYTHON_SSL=y
# BR2_PACKAGE_PYTHON_UNICODEDATA is not set
BR2_PACKAGE_PYTHON_ZLIB=y
BR2_PACKAGE_PYTHON_DAEMON=y
BR2_PACKAGE_PYTHON_NETIFACES=y
BR2_PACKAGE_PYTHON_POSIX_IPC=y
BR2_PACKAGE_PYTHON_PYYAML=y
BR2_PACKAGE_PYTHON_SIMPLEJSON=y
BR2_PACKAGE_DROPBEAR=y
BR2_PACKAGE_IFPLUGD=y
BR2_PACKAGE_NETCAT=y
BR2_PACKAGE_NTP=y
# BR2_PACKAGE_NTP_NTPD is not set
BR2_PACKAGE_NTP_NTPDATE=y
BR2_PACKAGE_SCREEN=y
BR2_PACKAGE_CDEBOOTSTRAP=y
BR2_PACKAGE_DEBOOTSTRAP=y
BR2_PACKAGE_UTIL_LINUX_BINARIES=y
BR2_TARGET_ROOTFS_CPIO=y
BR2_TARGET_ROOTFS_CPIO_GZIP=y
# BR2_TARGET_ROOTFS_TAR is not set
```

## configs/excito_x86_defconfig
```kconfig
BR2_CCACHE=y
BR2_GLOBAL_PATCH_DIR="board/excito/x86/patches"
BR2_KERNEL_HEADERS_3_18=y
BR2_UCLIBC_CONFIG_FRAGMENT_FILES="board/excito/common/uclibc-step2.config"
BR2_TOOLCHAIN_BUILDROOT_WCHAR=y
BR2_TOOLCHAIN_BUILDROOT_CXX=y
BR2_TARGET_GENERIC_HOSTNAME="excito-install"
BR2_TARGET_GENERIC_ISSUE="Welcome to Excito Rescue/Install"
BR2_TARGET_GENERIC_ROOT_PASSWD="excito"
BR2_SYSTEM_BIN_SH_BASH=y
BR2_ROOTFS_OVERLAY="board/excito/common/rootfs-step2-overlay"
BR2_ROOTFS_POST_BUILD_SCRIPT="board/excito/x86/post-build.sh"
BR2_LINUX_KERNEL=y
BR2_LINUX_KERNEL_CUSTOM_VERSION=y
BR2_LINUX_KERNEL_CUSTOM_VERSION_VALUE="3.18.21"
BR2_LINUX_KERNEL_USE_CUSTOM_CONFIG=y
BR2_LINUX_KERNEL_CUSTOM_CONFIG_FILE="board/excito/x86/linux-3.18.21.config"
BR2_PACKAGE_BUSYBOX_CONFIG_FRAGMENT_FILES="board/excito/common/busybox-step2.config"
BR2_PACKAGE_BUSYBOX_SHOW_OTHERS=y
BR2_PACKAGE_BTRFS_PROGS=y
BR2_PACKAGE_CIFS_UTILS=y
BR2_PACKAGE_DOSFSTOOLS=y
BR2_PACKAGE_DOSFSTOOLS_FATLABEL=y
BR2_PACKAGE_DOSFSTOOLS_FSCK_FAT=y
BR2_PACKAGE_DOSFSTOOLS_MKFS_FAT=y
BR2_PACKAGE_E2FSPROGS_RESIZE2FS=y
BR2_PACKAGE_ECRYPTFS_UTILS=y
BR2_PACKAGE_FSARCHIVER=y
BR2_PACKAGE_CRYPTSETUP=y
BR2_PACKAGE_GPTFDISK=y
BR2_PACKAGE_GPTFDISK_GDISK=y
BR2_PACKAGE_GPTFDISK_SGDISK=y
BR2_PACKAGE_HDPARM=y
BR2_PACKAGE_MDADM=y
BR2_PACKAGE_PYTHON=y
BR2_PACKAGE_PYTHON_SSL=y
# BR2_PACKAGE_PYTHON_UNICODEDATA is not set
BR2_PACKAGE_PYTHON_ZLIB=y
BR2_PACKAGE_PYTHON_DAEMON=y
BR2_PACKAGE_PYTHON_NETIFACES=y
BR2_PACKAGE_PYTHON_POSIX_IPC=y
BR2_PACKAGE_PYTHON_PYYAML=y
BR2_PACKAGE_PYTHON_SIMPLEJSON=y
BR2_PACKAGE_DROPBEAR=y
BR2_PACKAGE_IFPLUGD=y
BR2_PACKAGE_NETCAT=y
BR2_PACKAGE_NTP=y
# BR2_PACKAGE_NTP_NTPD is not set
BR2_PACKAGE_NTP_NTPDATE=y
BR2_PACKAGE_SCREEN=y
BR2_PACKAGE_CDEBOOTSTRAP=y
BR2_PACKAGE_DEBOOTSTRAP=y
BR2_PACKAGE_UTIL_LINUX_BINARIES=y
BR2_TARGET_ROOTFS_ISO9660=y
# BR2_TARGET_ROOTFS_TAR is not set
BR2_TARGET_GRUB=y
```

## package/cdebootstrap/Config.in
```kconfig
config BR2_PACKAGE_CDEBOOTSTRAP
	bool "cdebootstrap"
	select BR2_PACKAGE_GNUPG2
	select BR2_PACKAGE_GNUPG_GPGV2
	select BR2_PACKAGE_DEBIAN_ARCHIVE_KEYRING
	select BR2_PACKAGE_LIBDEBIAN_INSTALLER
	select BR2_PACKAGE_BZIP2
	select BR2_PACKAGE_LIBCURL
	select BR2_PACKAGE_XZ
	help
	  cdebootstrap generates systems from scratch for Debian and derivates.

	  This is implementation is different from debootstrap. It features a different package selection. The package selection is done according to the flavour.
```

## package/debian-archive-keyring/Config.in
```kconfig
config BR2_PACKAGE_DEBIAN_ARCHIVE_KEYRING
	bool "debian archive keyring"
	select BR2_PACKAGE_HOST_JETRING
	select BR2_PACKAGE_GNUPG2
	select BR2_PACKAGE_GNUPG2_GPGV
	help
	  The Debian project digitally signs its Release files. This package contains the archive keys used for that.
```

## package/debootstrap/Config.in
```kconfig
config BR2_PACKAGE_DEBOOTSTRAP
	bool "debootstrap"
	select BR2_PACKAGE_GNUPG
	select BR2_PACKAGE_GNUPG_GPGV
	select BR2_PACKAGE_DEBIAN_ARCHIVE_KEYRING
	help
	  debootstrap is used to create a Debian base system from scratch, without requiring the availability of dpkg or apt. It does this by downloading .deb files from a mirror site, and carefully unpacking them into a directory which can eventually be chrooted into. 
```

## package/dpkg-deb/Config.in.host
```kconfig
config BR2_PACKAGE_HOST_DPKG_DEB
	bool "host dpkg-deb"
	select BR2_PACKAGE_ZLIB
	help
	  dpkg-deb packs, unpacks and provides information about Debian archives.
```

## package/excito-installer/Config.in
```kconfig
config BR2_PACKAGE_EXCITO_INSTALLER
	bool "excito-installer"
	select BR2_PACKAGE_PYTHON
	select BR2_PACKAGE_PYTHON_DAEMON
	select BR2_PACKAGE_PYTHON_NETIFACES
	help
	  excito-installer is a set of python scripts to install excito images
```

## package/fsarchiver/Config.in
```kconfig
comment "Note that fsarchiver needs a toolchain with UCLIBC_HAS_WORDEXP enabled"
	depends on BR2_PACKAGE_FSARCHIVER

config BR2_PACKAGE_FSARCHIVER
	bool "fsarchiver"
	select BR2_PACKAGE_ZLIB
	select BR2_PACKAGE_BZIP2
	select BR2_PACKAGE_LIBGCRYPT
	select BR2_PACKAGE_UTIL_LINUX_LIBBLKID
	select BR2_PACKAGE_E2FSPROGS
	select BR2_PACKAGE_XZ
	select BR2_PACKAGE_ATTR
	help
	  fsarchiver is a system tool that allows you to save the contents of a file-system to a compressed archive file.
	  
	  The file-system can be restored on a partition which has a different size and it can be restored on a different file-system.
```

## package/jetring/Config.in.host
```kconfig
config BR2_PACKAGE_HOST_JETRING
	bool "host jetring"
	select BR2_PACKAGE_HOST_GNUPG2
	help
	  gpg keyring maintenance using changesets

	  jetring is a collection of tools that allow for gpg keyrings to be maintained using changesets. It was developed with the Debian keyring in mind, and aims to solve the problem that a gpg keyring is a binary blob that's hard for multiple people to collaboratively edit.

	  With jetring, changesets can be submitted, reviewed to see exactly what they will do, applied, and used to build a keyring. The origin of every change made to the keyring is available for auditing, and gpg signatures can be used to further secure things.
```

## package/libdebian-installer/Config.in
```kconfig
config BR2_PACKAGE_LIBDEBIAN_INSTALLER
	bool "libdebian-installer"
	select BR2_PACKAGE_CHECK
	help
	  This library is used by debian-installer to perform common functions such as logging messages and executing commands. If you aren't working on debian-installer or building your own install system based on debian-installer, then you probably don't need this library.
```

## package/python-pyblkid/Config.in
```kconfig
config BR2_PACKAGE_PYTHON_PYBLKID
	bool "python-pyblkid"
	depends on BR2_PACKAGE_PYTHON
	select BR2_PACKAGE_UTIL_LINUX_LIBBLKID
	help
	  Simple python binding for libblkid
```

## package/write-magic/Config.in
```kconfig
config BR2_PACKAGE_WRITE_MAGIC
	bool "write-magic"
	help
	  write-magic is exclusive to the Excito B3 platform ; It allows to write a special value into nvram in order to tell U-Boot to "shutdown" the system after rebooting.
```
